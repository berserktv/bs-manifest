## orange/hardknott/router-bs-swupdate/conf/local.conf
```bitbake
MACHINE ??= 'orange-pi-zero'
DISTRO ?= 'poky'
PACKAGE_CLASSES ?= "package_deb"
EXTRA_IMAGE_FEATURES ?= "debug-tweaks"
USER_CLASSES ?= "buildstats image-mklibs image-prelink"
PATCHRESOLVE = "noop"
BB_DISKMON_DIRS = "\
    STOPTASKS,${TMPDIR},1G,100K \
    STOPTASKS,${DL_DIR},1G,100K \
    STOPTASKS,${SSTATE_DIR},1G,100K \
    STOPTASKS,/tmp,100M,100K \
    ABORT,${TMPDIR},100M,1K \
    ABORT,${DL_DIR},100M,1K \
    ABORT,${SSTATE_DIR},100M,1K \
    ABORT,/tmp,10M,1K"
PACKAGECONFIG_append_pn-qemu-native = " sdl"
PACKAGECONFIG_append_pn-nativesdk-qemu = " sdl"
CONF_VERSION = "1"

DL_DIR ?= "${BSPDIR}/downloads/"

# size memory GPU for Raspberry Pi
###GPU_MEM = "128"
###GPU_MEM_256 = "112"
###GPU_MEM_512 = "160"
###GPU_MEM_1024 = "320"

# for libs: "mpeg2dec libmad ffmpeg x264"
LICENSE_FLAGS_WHITELIST += "commercial"
```

## raspberry/gatesgarth/router-bs-swupdate/conf/bblayers.conf
```bitbake
# POKY_BBLAYERS_CONF_VERSION is increased each time build/conf/bblayers.conf
# changes incompatibly
LCONF_VERSION = "6"
POKY_BBLAYERS_CONF_VERSION = "2"

BBPATH = "${TOPDIR}"
BSPDIR := "${@os.path.abspath(os.path.dirname(d.getVar('FILE', True)) + '/../..')}"
BBFILES ?= ""

BBLAYERS ?= " \
  ${BSPDIR}/sources/poky/meta \
  ${BSPDIR}/sources/poky/meta-poky \
  ${BSPDIR}/sources/poky/meta-yocto-bsp \
  ${BSPDIR}/sources/meta-openembedded/meta-oe \
  ${BSPDIR}/sources/meta-raspberrypi \
  ${BSPDIR}/sources/meta-swupdate \
  ${BSPDIR}/sources/router-bs/meta-router-bs \
  "
```

## raspberry/scarthgap/yocto-demo-minimal/conf/local.conf
```bitbake
MACHINE ??= 'raspberrypi4-64'
DISTRO ?= 'poky'
PACKAGE_CLASSES ?= "package_deb"
EXTRA_IMAGE_FEATURES ?= "debug-tweaks"
USER_CLASSES ?= "buildstats"
PATCHRESOLVE = "noop"
BB_DISKMON_DIRS = "\
    STOPTASKS,${TMPDIR},1G,100K \
    STOPTASKS,${DL_DIR},1G,100K \
    STOPTASKS,${SSTATE_DIR},1G,100K \
    STOPTASKS,/tmp,100M,100K \
    HALT,${TMPDIR},100M,1K \
    HALT,${DL_DIR},100M,1K \
    HALT,${SSTATE_DIR},100M,1K \
    HALT,/tmp,10M,1K"
PACKAGECONFIG:append:pn-qemu-native = " sdl"
PACKAGECONFIG:append:pn-nativesdk-qemu = " sdl"
CONF_VERSION = "2"

DL_DIR ?= "${BSPDIR}/downloads/"

# size memory GPU for Raspberry Pi
GPU_MEM = "128"
GPU_MEM_256 = "112"
GPU_MEM_512 = "160"
GPU_MEM_1024 = "320"

# for libs: "mpeg2dec libmad ffmpeg x264"
LICENSE_FLAGS_ACCEPTED += "commercial synaptics-killswitch"
```
